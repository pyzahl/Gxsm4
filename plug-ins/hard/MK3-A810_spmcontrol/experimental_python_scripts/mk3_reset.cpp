/* -*- Mode: C++; indent-tabs-mode: nil; c-basic-offset: 8 c-style: "K&R" -*- */

// g++ `pkg-config --libs  --cflags glib-2.0` mk3_reset.C -o mk3_reset

#include <locale.h>
#include <libintl.h>
#include <time.h>
#include <unistd.h>



#include <climits>    // for limits macrors
#include <iomanip>    // for setfill, setprecision, setw
#include <ios>        // for dec, hex, oct, showbase, showpos, etc.
#include <iostream>   // for cout
#include <sstream>    // for istringstream

#include <fcntl.h>
#include <sys/ioctl.h>

#include "string.h"
#include "glib.h"



#define FB_SPM_MAGIC_ADR  0x10F13F00 /**< Magic struct is at this fixed addess in external SRAM */
#define FB_SPM_MAGIC     0x3202EE01

#define SRDEV "/dev/sranger_mk2_0"

typedef gint32   DSP_INT;
typedef guint32  DSP_UINT;
typedef guint32  DSP_UINTA;
typedef gint16   DSP_INT16;
typedef guint16  DSP_UINT16;
typedef gint32   DSP_INT32;
typedef guint32  DSP_UINT32;
typedef gint64   DSP_INT64;
typedef guint64  DSP_UINT64;


/* read vendor and product IDs from the sranger */
#define SRANGER_MK2_IOCTL_VENDOR _IOR('U', 0x20, int)
#define SRANGER_MK2_IOCTL_PRODUCT _IOR('U', 0x21, int)
/* send/recv a control message to the sranger */
/* #define SRANGER_MK2_IOCTL_CTRLMSG _IOWR('U', 0x22, struct usb_ctrlrequest ) */

/* FIXME: These are NOT registered ioctls()'s */
#define SRANGER_MK2_IOCTL_ASSERT_DSP_RESET           73
#define SRANGER_MK2_IOCTL_RELEASE_DSP_RESET          74
#define SRANGER_MK23_IOCTL_ASSERT_DSP_RESET           73
#define SRANGER_MK23_IOCTL_RELEASE_DSP_RESET          74
#define SRANGER_MK2_IOCTL_INTERRUPT_DSP_FROM_HPI     75
#define SRANGER_MK2_IOCTL_W_LEDS                     76
#define SRANGER_MK2_IOCTL_HPI_MOVE_OUTREQUEST        77
#define SRANGER_MK2_IOCTL_HPI_MOVE_INREQUEST         78
#define SRANGER_MK2_IOCTL_HPI_CONTROL_REQUEST        79
#define SRANGER_MK2_IOCTL_SPEED_FAST                 83
#define SRANGER_MK2_IOCTL_SPEED_SLOW                 84
#define SRANGER_MK2_IOCTL_DSP_STATE_SET              85
#define SRANGER_MK2_IOCTL_DSP_STATE_GET              86
#define SRANGER_MK2_IOCTL_ERROR_COUNT                87
#define SRANGER_MK2_IOCTL_CLR_ERROR_COUNT            88
#define SRANGER_MK2_IOCTL_ABORT_KERNEL_OP            89

#define SRANGER_MK2_IOCTL_MBOX_K_WRITE               90
#define SRANGER_MK2_IOCTL_MBOX_K_READ                91
#define SRANGER_MK2_IOCTL_KERNEL_EXEC                92

#define SRANGER_MK23_IOCTL_QUERY_EXCLUSIVE_MODE      100
#define SRANGER_MK23_IOCTL_CLR_EXCLUSIVE_MODE        101
#define SRANGER_MK23_IOCTL_SET_EXCLUSIVE_AUTO        102
#define SRANGER_MK23_IOCTL_SET_EXCLUSIVE_UNLIMITED   103

#define SRANGER_MK23_SEEK_ATOMIC      1 // Bit indicates ATOMIC mode to be used
#define SRANGER_MK23_SEEK_DATA_SPACE  0 // DATA_SPACE, NON ATOMIC -- MK2: ONLY VIA USER PROVIDED NON ATOMIC KFUNC!!!!
#define SRANGER_MK23_SEEK_PROG_SPACE  2 // default mode
#define SRANGER_MK23_SEEK_IO_SPACE    4 // default mode

#define SRANGER_MK23_SEEK_EXCLUSIVE_AUTO 8 // request exclusive write access for device, auto released after following read access and always after close
#define SRANGER_MK23_SEEK_EXCLUSIVE_UNLIMITED 0x10 // request exclusive write access for device until reset by seek or after close

#define SRANGER_MK2_SEEK_DATA_SPACE  1
#define SRANGER_MK2_SEEK_PROG_SPACE  2
#define SRANGER_MK2_SEEK_IO_SPACE    3

#define SRANGER_ERROR(X) std::cerr << X



typedef struct {
	DSP_UINT32 magic;         /**< 0: Magic Number to validate entry =RO */
	DSP_UINT32 version;       /**< 1: SPM soft verion, BCD =RO */
	DSP_UINT32 year,mmdd;     /**< 2,3: year, date, BCD =RO */
	DSP_UINT32 dsp_soft_id;   /**< 4: Unique SRanger DSP software ID =RO */
	/* -------------------- Magic Symbol Table ------------------------------ */
	DSP_UINTA statemachine;  /**< 5: Address of statemachine struct =RO */
	DSP_UINTA AIC_in;        /**< 6: AIC in buffer =RO */
	DSP_UINTA AIC_out;       /**< 7: AIC out buffer =RO */
	DSP_UINTA AIC_reg;       /**< 8: AIC register (AIC control struct) =RO */
	/* -------------------- basic magic data set ends ----------------------- */
	DSP_UINTA feedback;      /**<  9: Address of feedback struct =RO */
	DSP_UINTA analog;        /**< 10: Address of analog struct =RO */
	DSP_UINTA scan;          /**< 11: Address of ascan struct =RO */
	DSP_UINTA move;          /**< 12: Address of move struct =RO */
	DSP_UINTA probe;         /**< 13: Address of probe struct =RO */
	DSP_UINTA autoapproach;  /**< 14: Address of autoapproch struct =RO */
	DSP_UINTA datafifo;      /**< 15: Address of datafifo struct =RO */
	DSP_UINTA probedatafifo; /**< 16: Address of probe datafifo struct =RO */
	DSP_UINTA scan_event_trigger;/**< 17: Address of scan_event_trigger struct =RO */
	DSP_UINTA feedback_mixer; /**< 18: Address of DFM FUZZY mix control parameter struct =RO */
	DSP_UINTA CR_out_puls;   /**< 19: Address of CoolRunner IO Out Puls action struct =RO */
	DSP_UINTA external;      /**< 20: Address of external control struct =RO */
	DSP_UINTA CR_generic_io; /**< 21: Address of CR_generic_io struct =RO */
	DSP_UINTA a810_config;   /**< 22: Address of a810_config struct =RO */
	DSP_UINTA watch;         /**< 23: Address of watch struct if available =RO */
	DSP_UINTA dummy1, dummy2; /**< --: Address of xxx struct =RO */
	DSP_UINT32 dummyl;         /**< --: Address of xxx struct =RO */
} SPM_MAGIC_DATA_LOCATIONS;


void p32(const gchar *l, gint32 x) {
	gchar *info = g_strdup_printf ("0x%08x", x);
	std::cout << l << " = " << info << " [32] = " << x << std::endl;
}

void p16(const gchar *l, gint32 x) {
	gchar *info = g_strdup_printf ("0x%08x", x);
	std::cout << l << " = " << info << " [16] = " << x << std::endl;
}

void pu32(const gchar *l, guint32 x) {
	gchar *info = g_strdup_printf ("0x%08u", x);
	std::cout << l << " = " << info << " [u32] = " << x << std::endl;
}

void dumpbuffer(unsigned char *buffer, int bi, int bf, int a_base=0){
	int i, j;
	unsigned char tmp[16];
	for(i=bi; i<=bf; i+=16){
		memset (tmp, 0, 16);
		for(j=0; (i+j) <= bf && j<16; ++j) tmp[j] = buffer[i+j];
		g_print("%06X: %02x %02x %02x %02x  %02x %02x %02x %02x  %02x %02x %02x %02x  %02x %02x %02x %02x\n", a_base + i,
                        tmp[0],tmp[1],tmp[2],tmp[3],tmp[4],tmp[5],tmp[6],tmp[7],
                        tmp[8],tmp[9],tmp[10],tmp[11],tmp[12],tmp[13],tmp[14],tmp[15]);
	}
}

/*
        ########## MK3 HARD RESET PROCEDURE ##########
        #        
        #- Send a USB request (DSP Reset):
        #	- Direction: OUT (0)
        #	- RequestType: Vendor (2)
        #	- Recipient: Device (0) 	
        #	- Request: 0x10 (16-bit)
        #	- Value: 1 for a reset (16-bit)
        #	- Index: 0 (16-bit)
        #- Wait 250 ms
        #- Send a USB request (Remove DSP reset):
        #	- Direction: OUT (0)
        #	- RequestType: Vendor (2)
        #	- Recipient: Device (0) 	
        #	- Request: 0x10 (16-bit)
        #	- Value: 0 to remove the reset (16-bit)
        #	- Index: 0 (16-bit)
        #- Wait 250 ms
        #- Write 0x101 in the HPIC
        #	- Send a USB request (DSP Reset):
        #		- Direction: OUT (0)
        #		- RequestType: Vendor (2)
        #		- Recipient: Device (0) 	
        #		- Request: 0x14 (16-bit)
        #		- Value: 0x101 (16-bit)
        #		- Index: 0 (16-bit)
        #- Write the power-up kernel (see attached file for the addresses and data, all numbers are in hex format): with HPI write USB requests.
        #- Write the Entry point of the power-up kernel (value 32-bit 0x10E09860) at the address 0x1C40008 with a HPI write USB request.
        #- Write the the value 0x1 (32-bit) at the address 0x1C4000C with a HPI write USB request.
        #- Wait 10 ms
        #- Send a USB request (Set HPI speed):
        #	- Direction: OUT (0)
        #	- RequestType: Vendor (2)
        #	- Recipient: Device (0) 	
        #	- Request: 0x15 (16-bit)
        #	- Value: 1 to set the fast mode (16-bit)
        #	- Index: 0 (16-bit)
        #- Send a USB request (Set the DSP state):
        #	- Direction: OUT (0)
        #	- RequestType: Vendor (2)
        #	- Recipient: Device (0) 	
        #	- Request: 0x20 (16-bit)
        #	- Value: 0 (16-bit)
        #	- Index: 0 (16-bit)
        #	- And the bytes 1 and 0 (to indicate mode Power_Up_Kernel and Com_Idle)          
        #########
*/


//# MK3 COFF TEXT DSP CODE for power up kernel

guint section_addr[] = { 0x10800800,  0x10800804, 0x10800808,  0x1080080C,  0x10800810,  0x10E08080,  0x10E08200,   0x10E09000, 0 };

guint16 s0x10800800[] = {0x0000, 0x0000, 0x0000, 0x0000, 0xffff};
guint16 s0x10800804[] = {0x0000, 0x0000, 0x0000, 0x0000, 0xffff};
guint16 s0x10800808[] = {0x0001, 0x0000, 0x0000, 0x0000, 0xffff};
guint16 s0x1080080C[] = {0x0040, 0x0099, 0x00E0, 0x0010, 0xffff};
guint16 s0x10800810[] = {0x0040, 0x0099, 0x00E0, 0x0010, 0xffff};
guint16 s0x10E08080[] = {0x0012, 0x0030, 0x0000, 0x0000, 0x0000, 0x0000, 0x0000, 0x0000,
			 0x0000, 0x0000, 0x0000, 0x0000, 0x0000, 0x0000, 0x0000, 0x0000,
			 0x0000, 0x0000, 0x0000, 0x0000, 0x0000, 0x0000, 0x0000, 0x0000,
			 0x0000, 0x0000, 0x0000, 0x0000, 0x0000, 0x0000, 0x0000, 0x0000, 0xffff};
guint16 s0x10E08200[] = {0x0052, 0x0080, 0x00FF, 0x0007, 0x00C6, 0x0023, 0x003C, 0x0000,
			 0x00E2, 0x0003, 0x0018, 0x0000, 0x00E3, 0x0003, 0x00EC, 0x0000,
			 0x0085, 0x009C, 0x0095, 0x00BC, 0x00E2, 0x0003, 0x0004, 0x0000,
			 0x0085, 0x00DC, 0x0023, 0x0000, 0x0000, 0x0002, 0x0000, 0x00EA,
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			 0x0000, 0x0000, 0x0000, 0x0000, 0x0000, 0x0000, 0x0000, 0x0000, 0xffff};

guint16 s0x10E09000[] = {0x0046, 0x0052, 0x004E, 0x0002, 0x0028, 0x0000, 0x008C, 0x0003,
                         0x00A0, 0x004C, 0x0000, 0x0000, 0x0068, 0x00E2, 0x0080, 0x0003,
                         0x0078, 0x00E0, 0x0000, 0x0002, 0x002A, 0x0000, 0x000D, 0x0000,
                         0x006A, 0x00E2, 0x0000, 0x0000, 0x0001, 0x0000, 0x0020, 0x00E0,
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                         0x0000, 0x0000, 0x0000, 0x0000, 0x0000, 0x0000, 0x0000, 0x0000, 0xffff};

guint16 *section_texts[] = {  s0x10800800,  s0x10800804, s0x10800808,  s0x1080080C,  s0x10800810,  s0x10E08080,  s0x10E08200,   s0x10E09000, 0 };

/*
  ########## MK3 HARD RESET PROCEDURE ##########
  #        
  #- Send a USB request (DSP Reset):
  #	- Direction: OUT (0)
  #	- RequestType: Vendor (2)
  #	- Recipient: Device (0) 	
  #	- Request: 0x10 (16-bit)
  #	- Value: 1 for a reset (16-bit)
  #	- Index: 0 (16-bit)
  #- Wait 250 ms
  #- Send a USB request (Remove DSP reset):
  #	- Direction: OUT (0)
  #	- RequestType: Vendor (2)
  #	- Recipient: Device (0) 	
  #	- Request: 0x10 (16-bit)
  #	- Value: 0 to remove the reset (16-bit)
  #	- Index: 0 (16-bit)
  #- Wait 250 ms
  #- Write 0x101 in the HPIC
  #	- Send a USB request (DSP Reset):
  #		- Direction: OUT (0)
  #		- RequestType: Vendor (2)
  #		- Recipient: Device (0) 	
  #		- Request: 0x14 (16-bit)
  #		- Value: 0x101 (16-bit)
  #		- Index: 0 (16-bit)
  #- Write the power-up kernel (see attached file for the addresses and data, all numbers are in hex format): with HPI write USB requests.
  #- Write the Entry point of the power-up kernel (value 32-bit 0x10E09860) at the address 0x1C40008 with a HPI write USB request.
  #- Write the the value 0x1 (32-bit) at the address 0x1C4000C with a HPI write USB request.
  #- Wait 10 ms
  #- Send a USB request (Set HPI speed):
  #	- Direction: OUT (0)
  #	- RequestType: Vendor (2)
  #	- Recipient: Device (0) 	
  #	- Request: 0x15 (16-bit)
  #	- Value: 1 to set the fast mode (16-bit)
  #	- Index: 0 (16-bit)
  #- Send a USB request (Set the DSP state):
  #	- Direction: OUT (0)
  #	- RequestType: Vendor (2)
  #	- Recipient: Device (0) 	
  #	- Request: 0x20 (16-bit)
  #	- Value: 0 (16-bit)
  #	- Index: 0 (16-bit)
  #	- And the bytes 1 and 0 (to indicate mode Power_Up_Kernel and Com_Idle)          
  #########
*/



void hpi_move (int dsp, guint address, guint16 *data, gint verify=1){
        int ret=0;
        struct {
                guint32 address;
                guint16 length;
                void* buffer;
        } arg;
        guchar buffer[4096];
        guchar vbuffer[4096];
        int length = 0;
        for (int i=0; i<4096 && data[i] < 0x0100; ++i){
                buffer[length++] = guchar(data[i]);
                //g_print("%02x ", guchar(data[i]));
        }
        dumpbuffer(buffer,0,length-1, address);
   
        g_print ("HPI MOVE: [0x%08x] %d bytes... ", address, length);
        arg.address = address;
        arg.length = length;
        arg.buffer = buffer;
        ret=ioctl(dsp, SRANGER_MK2_IOCTL_HPI_MOVE_OUTREQUEST, (unsigned long)&arg);
        if (ret != length)
                g_print ("HPI MOVE ERROR: %d bytes moved of %d.\n", ret, length);
        else
                g_print ("HPI MOVE OK: all %d bytes moved.\n", ret);

        // TEST for error checking, wrinting wrong bytes for test
        //arg.address = address+10;
        //arg.length = 4;
        //ret=ioctl(dsp, SRANGER_MK2_IOCTL_HPI_MOVE_OUTREQUEST, (unsigned long)&arg);


        if (verify){
                g_print ("Verifying Text now...\n", ret);
                arg.address = address;
                arg.length = length;
                arg.buffer = vbuffer;
                ret=ioctl(dsp, SRANGER_MK2_IOCTL_HPI_MOVE_INREQUEST, (unsigned long)&arg);
                if (ret != length)
                        g_print ("HPI MOVE IN ERROR: %d bytes moved of %d.\n", ret, length);
                else
                        g_print ("HPI MOVE IN OK: all %d bytes moved.\n", ret);
                int verr=0;
                for (int i=0; i<length; ++i){
                        if (vbuffer[i] != buffer[i]){
                                g_print ("VERR at 0x%08x %02x not matching %02x\n", i+address, vbuffer[i], buffer[i]);
                                verr++;
                        }
                }
                if (verr)
                        g_print ("%d errors.\n", verr);
                else
                        g_print ("Verify OK.\n");
        }
   
}	

void issue_mk3_hard_reset (int dsp){
        int i;
        int ret=0;
        g_print ("\nMK3 issue hardware reset and restart from flash.\n");

        g_print ("MK3 HPI RESET SET... ");
        ret=ioctl (dsp, SRANGER_MK23_IOCTL_ASSERT_DSP_RESET, 0);
        g_print ("->%d\n", ret);
        usleep(250000);
        g_print ("MK3 HPI RESET RELEASE... ");
        ret=ioctl (dsp, SRANGER_MK23_IOCTL_RELEASE_DSP_RESET, 0);
        g_print ("->%d\n", ret);
        usleep(250000);
        g_print ("MK3 HPI CONTROL 0x101 to HPIC... ");
        ret=ioctl (dsp, SRANGER_MK2_IOCTL_HPI_CONTROL_REQUEST, 0x101);
        g_print ("->%d\n", ret);

        g_print ("MK3 HPI MOVE POWER-UP KERNEL UPLOAD\n");
        //#- Write the power kernel sections
        for (int i=0; section_addr[i]; ++i){
                g_print ("MK3 HPI MOVE POWER-UP KERNEL UPLOAD SECTION at 0x%x\n", section_addr[i]);
                hpi_move (dsp, section_addr[i], section_texts[i]);
        }                   
        g_print ("MK3 HPI MOVE ENTRY POINT ADDRESS\n");
        //#- Write the Entry point of the power-up kernel (value 32-bit 0x10E09860) at the address 0x1C40008 with a HPI write USB request.
        guint16 tmp[8] = {0,0,0,0, 0,0,0,0};
        guint32 tmp1 = 0x10E09860;
        guchar *tmp8;
        tmp8 = (guchar*)(&tmp1);
        for (i=0; i<4; ++i) tmp[i] = tmp8[i]; tmp[4]=0xffff;
        hpi_move (dsp, 0x1C40008, tmp);
        //#- Write the the value 0x1 (32-bit) at the address 0x1C4000C with a HPI write USB request.
        guint32 tmp2 = 0x00000001;
        tmp8 = (guchar*)(&tmp2);
        for (i=0; i<4; ++i) tmp[i] = tmp8[i]; tmp[4]=0xffff;
        hpi_move (dsp, 0x1C4000C, tmp);
  
        usleep(100000);

        g_print ("MK3 SPEED FAST...");
        ret=ioctl (dsp, SRANGER_MK2_IOCTL_SPEED_FAST, 0);
        g_print ("->%d\n", ret);
        g_print ("MK3 STATE SET 1... ");
        ret=ioctl (dsp, SRANGER_MK2_IOCTL_DSP_STATE_SET, 0);
        g_print ("->%d\n", ret);
        g_print ("MK3 SET LED GREEN... ");
        ret=ioctl (dsp, SRANGER_MK2_IOCTL_W_LEDS, 2);
        g_print ("->%d\n", ret);

        g_print ("MK3 POWER UP RESET CYCLE INITATED.\n\n");
}

int main ( int argc, char **argv ){
	int dsp=0;
	SPM_MAGIC_DATA_LOCATIONS magic;
        
	magic.magic = 0; // set to zero, this means all data is invalid!

        if (argc > 1){
                if((dsp = open (argv[1], O_RDWR)) <= 0){
                        std::cerr << "Can not open " << argv[1] << std::endl;
                        return -1;
                }
        } else {
        
                if((dsp = open (SRDEV, O_RDWR)) <= 0){
                        std::cerr << "Can not open " << SRDEV << std::endl;
                        return -1;
                }
        }

        if (dsp) {
		int ret;
		unsigned int vendor, product;

		issue_mk3_hard_reset (dsp);

		if ((ret=ioctl(dsp, SRANGER_MK2_IOCTL_VENDOR, (unsigned long)&vendor)) < 0){
			SRANGER_ERROR(strerror(ret) << " cannot query VENDOR" << std::endl);
			close (dsp);
			dsp = 0;
			return -1;
		}
		if ((ret=ioctl(dsp, SRANGER_MK2_IOCTL_PRODUCT, (unsigned long)&product)) < 0){
			SRANGER_ERROR(strerror(ret) << " cannot query PRODUCT" << std::endl);
			close (dsp);
			dsp = 0;
			return -1;
		}

		gchar *info = g_strdup_printf ("SignalRanger Vendor 0x%04x : Product 0x%04x", vendor, product);
		std::cout << info << std::endl;

		p32 ("Reading DSP Code Magic, size", sizeof (magic));

		// now read magic struct data
		lseek (dsp, FB_SPM_MAGIC_ADR, SRANGER_MK2_SEEK_DATA_SPACE);
		if ((ret=read (dsp, &magic, sizeof (magic))) < 0){
			SRANGER_ERROR(strerror(ret) << " READ ERROR" << std::endl);
		}

		dumpbuffer ( (unsigned char*)&magic, 0, sizeof (magic)-1);

		p32 ("magic", magic.magic);
                //		p32 ("magic", GUINT32_FROM_LE (magic.magic));

		p32 ("version", magic.version);
		p32 ("year", magic.year);
		p32 ("mmdd", magic.mmdd);
		p32 ("softid", magic.dsp_soft_id);
		p32 ("statemachine", magic.statemachine);

		close (dsp);
	}
	
	return 0;
}
